## Coin cell firmware/build/Kconfig/boards/Kconfig
```kconfig
# Load Zephyr board Kconfig descriptions.
osource "/home/smalab/ncs/v3.2.1/zephyr/boards/nordic/nrf5340dk/Kconfig"
```

## Coin cell firmware/build/phase2-firmware/Kconfig/boards/Kconfig.nrf5340dk
```kconfig
# Load board Kconfig descriptions.
osource "/home/smalab/ncs/v3.2.1/zephyr/boards/nordic/nrf5340dk/Kconfig.nrf5340dk"
```

## Normal-Firmware/build/phase2-firmware/Kconfig/boards/Kconfig.defconfig
```kconfig
# Load Zephyr board defconfig descriptions.
osource "/home/smalab/ncs/v3.2.1/zephyr/boards/nordic/nrf5340dk/Kconfig.defconfig"
```

## phase2-firmware/build/Kconfig/arch/Kconfig
```kconfig
# Load Zephyr Arch Kconfig descriptions.
osource "/home/smalab/ncs/v3.2.1/zephyr/arch/rx/Kconfig"
osource "/home/smalab/ncs/v3.2.1/zephyr/arch/x86/Kconfig"
osource "/home/smalab/ncs/v3.2.1/zephyr/arch/xtensa/Kconfig"
osource "/home/smalab/ncs/v3.2.1/zephyr/arch/sparc/Kconfig"
osource "/home/smalab/ncs/v3.2.1/zephyr/arch/riscv/Kconfig"
osource "/home/smalab/ncs/v3.2.1/zephyr/arch/posix/Kconfig"
osource "/home/smalab/ncs/v3.2.1/zephyr/arch/mips/Kconfig"
osource "/home/smalab/ncs/v3.2.1/zephyr/arch/arm64/Kconfig"
osource "/home/smalab/ncs/v3.2.1/zephyr/arch/arm/Kconfig"
osource "/home/smalab/ncs/v3.2.1/zephyr/arch/arc/Kconfig"
```
