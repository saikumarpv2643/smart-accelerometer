## prj.conf
```kconfig
# ============================================
# ISRO Coin-Cell Accelerometer - Rev 3
# ============================================
# Architecture: ISR sampling + burst BLE TX
# Sample: 10 bytes, Packet: 243 bytes (24 samples)

# ==========================
# Core System Configuration
# ==========================
CONFIG_MAIN_STACK_SIZE=4096
CONFIG_HEAP_MEM_POOL_SIZE=8192
CONFIG_SYSTEM_WORKQUEUE_STACK_SIZE=2048
CONFIG_ASSERT=y

# ==========================
# Logging
# ==========================
CONFIG_LOG=y
CONFIG_LOG_MODE_DEFERRED=y
CONFIG_LOG_DEFAULT_LEVEL=3
CONFIG_LOG_BUFFER_SIZE=4096

# ==========================
# Bluetooth Core
# ==========================
CONFIG_BT=y
CONFIG_BT_PERIPHERAL=y
CONFIG_BT_DEVICE_NAME="ISRO_AccelSensor"
CONFIG_BT_MAX_CONN=1
CONFIG_BT_DEVICE_APPEARANCE=0

# ==========================
# GATT Configuration
# ==========================
CONFIG_BT_GATT_DYNAMIC_DB=y
CONFIG_BT_ATT_PREPARE_COUNT=5
CONFIG_BT_GATT_NOTIFY_MULTIPLE=y
CONFIG_BT_GATT_CLIENT=y

# ==========================
# BLE MTU and Buffer Sizes
# ==========================
# Packet = 243 bytes payload + 3 ATT header = 246 minimum
# Add margin for L2CAP headers and alignment
CONFIG_BT_L2CAP_TX_MTU=251
CONFIG_BT_BUF_ACL_TX_SIZE=255
CONFIG_BT_BUF_ACL_RX_SIZE=255
CONFIG_BT_ATT_TX_COUNT=10
CONFIG_BT_CONN_TX_MAX=10

# BLE Data Length Extension (DLE) for high throughput
CONFIG_BT_CTLR_DATA_LENGTH_MAX=251
CONFIG_BT_DATA_LEN_UPDATE=y

# ==========================
# BLE Connection Parameters
# ==========================
CONFIG_BT_GAP_AUTO_UPDATE_CONN_PARAMS=y
# Prefer fast connection interval for burst mode
CONFIG_BT_PERIPHERAL_PREF_MIN_INT=6
CONFIG_BT_PERIPHERAL_PREF_MAX_INT=12
CONFIG_BT_PERIPHERAL_PREF_LATENCY=0
# Prefer fast connection interval for burst mode
CONFIG_BT_PERIPHERAL_PREF_MIN_INT=6
CONFIG_BT_PERIPHERAL_PREF_MAX_INT=12
CONFIG_BT_PERIPHERAL_PREF_LATENCY=0
CONFIG_BT_PERIPHERAL_PREF_TIMEOUT=100

# Low Power Mode (Required for 4Hz Burst)
CONFIG_BT_CTLR_TX_PWR_MINUS_8=y

# ==========================
# Settings (Persistent Storage)
# ==========================
CONFIG_SETTINGS=y
CONFIG_BT_SETTINGS=y
CONFIG_FLASH=y
CONFIG_FLASH_PAGE_LAYOUT=y
CONFIG_FLASH_MAP=y
CONFIG_NVS=y

# ==========================
# DK LEDs and Buttons
# ==========================
CONFIG_DK_LIBRARY=y

# ==========================
# Console (Disabled for Coin-Cell Power Saving)
# ==========================
CONFIG_CONSOLE=n
CONFIG_UART_CONSOLE=n
CONFIG_SERIAL=n
CONFIG_LOG=n

# ==========================
# Float & CRC Support
# ==========================
CONFIG_FPU=y
CONFIG_NEWLIB_LIBC=y
CONFIG_CRC=y

# ==========================
# I2C Driver (Direct access, no Zephyr sensor API)
# ==========================
CONFIG_I2C=y
# Disable Zephyr sensor API for direct control
# CONFIG_SENSOR=y
# CONFIG_MPU6050=y

# ==========================
# Power Management (for coin-cell mode)
# ==========================
# CONFIG_PM=y
# CONFIG_PM_DEVICE=y
```

## src/main.c
```c
/**
 * @file main.c
 * @brief Coin-Cell Wireless Accelerometer Firmware
 *
 * Architecture: Rev 3
 * - ISR-driven 1 kHz sampling with minimal work in ISR
 * - High-priority reader thread for I2C reads
 * - Ring buffer for 1024 samples
 * - Burst transmission every ~1 second (coin-cell mode)
 * - Continuous streaming (lab mode with external power)
 */

#include <dk_buttons_and_leds.h>
#include <zephyr/bluetooth/bluetooth.h>
#include <zephyr/bluetooth/conn.h>
#include <zephyr/bluetooth/gatt.h>
#include <zephyr/drivers/i2c.h>
#include <zephyr/kernel.h>
#include <zephyr/logging/log.h>
#include <zephyr/settings/settings.h>
#include <zephyr/spinlock.h>
#include <zephyr/sys/crc.h>

#include "accel_service.h"

/* Coin-cell mode: reduce logging to save power */
#ifdef CONFIG_COINCELL_MODE
LOG_MODULE_REGISTER(main, LOG_LEVEL_WRN);
#else
LOG_MODULE_REGISTER(main, LOG_LEVEL_INF);
#endif

/*============================================================================
 * Configuration
 *===========================================================================*/

#define SAMPLE_FREQ_HZ 1000
#define SAMPLE_PERIOD_US (1000000 / SAMPLE_FREQ_HZ) /* 1000 µs */

/* MPU6050 Registers */
#define MPU6050_ADDR 0x68
#define MPU6050_ACCEL_XOUT_H 0x3B
#define MPU6050_PWR_MGMT_1 0x6B
#define MPU6050_SMPLRT_DIV 0x19
#define MPU6050_CONFIG 0x1A
#define MPU6050_ACCEL_CONFIG 0x1C

/* Burst mode timing */
#define SAMPLES_BEFORE_BURST                                                   \
  250 /* 250 samples = ~0.25s latency (Compromise: Safe & Fast) */
#define INTER_PACKET_DELAY_MS 2 /* Prevent coin-cell brownout */

/*============================================================================
 * Hardware Devices
 *===========================================================================*/

static const struct device *i2c_dev;

/*============================================================================
 * Ring Buffer (Shared between ISR/Thread and Burst Controller)
 *===========================================================================*/

static accel_sample_t ring_buffer[RING_BUFFER_SAMPLES];
/* Spinlock to protect ring buffer indices from race conditions */
static struct k_spinlock buffer_lock;
static volatile uint16_t write_idx = 0;
static volatile uint16_t read_idx = 0;
static volatile uint16_t sample_counter = 0;
static volatile uint32_t burst_start_ms = 0;

/* Flag to pause sampling during heavy BLE activity (Coin-Cell only) */
static volatile bool sampling_paused = false;

/*============================================================================
 * Synchronization
 *===========================================================================*/

/* Semaphore depth must be unbounded to prevent losing ISR signals */
K_SEM_DEFINE(sample_ready_sem, 0, K_SEM_MAX_LIMIT);
K_SEM_DEFINE(burst_ready_sem, 0, K_SEM_MAX_LIMIT);

static volatile uint16_t pending_timestamp_ms = 0;

/*============================================================================
 * Statistics
 *===========================================================================*/

static uint32_t total_samples = 0;
static volatile uint32_t samples_overflowed =
    0; /* Ring buffer overflow count */
static uint32_t total_bursts = 0;
static uint32_t packets_sent = 0;
static uint32_t packets_failed = 0;

/* MTU tracking - need >= 246 for 243-byte packets */
static volatile bool mtu_ready = false;
static volatile uint16_t current_mtu = 23; /* Default BLE MTU */
#define REQUIRED_MTU 246 /* 243 payload + 3 ATT header (opcode + handle) */

/*============================================================================
 * Timer ISR - Minimal work, deterministic timing
 *===========================================================================*/

static void sample_timer_handler(struct k_timer *timer) {
  ARG_UNUSED(timer);

  /* Fix: Pause sampling if requested (prevents overflow during burst) */
  if (sampling_paused) {
    return;
  }

  /* Capture timestamp BEFORE any variable latency */
  pending_timestamp_ms = (uint16_t)(k_uptime_get_32() - burst_start_ms);

  /* Signal reader thread - NO I2C work here! */
  k_sem_give(&sample_ready_sem);
}

K_TIMER_DEFINE(sample_timer, sample_timer_handler, NULL);

/*============================================================================
 * Diagnostics Timer
 *===========================================================================*/

static void diagnostics_timer_handler(struct k_timer *timer) {
  LOG_INF("STATS: Samples=%u | Dropped=%u | Pkts Sent=%u | Failed=%u",
          total_samples, samples_overflowed, packets_sent, packets_failed);
}

K_TIMER_DEFINE(diagnostics_timer, diagnostics_timer_handler, NULL);

/*============================================================================
 * High-Priority Sample Reader Thread
 *
 * Does I2C read OUTSIDE of ISR to avoid blocking and jitter.
 * Runs at priority 0 (highest) to minimize latency after ISR signal.
 *===========================================================================*/

static void sample_reader_thread_fn(void *p1, void *p2, void *p3) {
  ARG_UNUSED(p1);
  ARG_UNUSED(p2);
  ARG_UNUSED(p3);

  uint8_t raw_data[6];
  int ret;

  LOG_INF("Sample reader thread started");

  while (1) {
    /* Wait for ISR signal */
    k_sem_take(&sample_ready_sem, K_FOREVER);

    /* Capture timestamp locally to avoid race with ISR */
    uint16_t local_timestamp = pending_timestamp_ms;

    /* Ring buffer overflow protection: drop sample if full */
    uint16_t samples_pending = write_idx - read_idx;
    if (samples_pending >= RING_BUFFER_SAMPLES) {
      samples_overflowed++;
      continue; /* Drop THIS sample - never block ISR/sampling */
    }

    /* Read accelerometer data via I2C - this takes ~300µs */
    ret = i2c_burst_read(i2c_dev, MPU6050_ADDR, MPU6050_ACCEL_XOUT_H, raw_data,
                         6);
    if (ret < 0) {
      LOG_WRN("I2C read failed: %d", ret);
      continue;
    }

    /* Pack sample into ring buffer - Protected by Spinlock */
    k_spinlock_key_t key = k_spin_lock(&buffer_lock);

    uint16_t idx = write_idx & RING_BUFFER_MASK;
    ring_buffer[idx].sample_counter = sample_counter;
    ring_buffer[idx].rel_timestamp_ms = local_timestamp;
    ring_buffer[idx].accel_x = (int16_t)((raw_data[0] << 8) | raw_data[1]);
    ring_buffer[idx].accel_y = (int16_t)((raw_data[2] << 8) | raw_data[3]);
    ring_buffer[idx].accel_z = (int16_t)((raw_data[4] << 8) | raw_data[5]);

    write_idx++;
    sample_counter++;
    total_samples++;

    /* Check if buffer is full (time for burst) */
    samples_pending = write_idx - read_idx;
    k_spin_unlock(&buffer_lock, key);

    if (samples_pending >= SAMPLES_BEFORE_BURST) {
      k_sem_give(&burst_ready_sem);
    }
  }
}

K_THREAD_DEFINE(sample_reader, 1024, sample_reader_thread_fn, NULL, NULL, NULL,
                0, 0, 0); /* Priority 0 = highest */

/*============================================================================
 * Burst Controller Thread
 *
 * Waits for buffer to fill, then transmits all packets.
 * In coin-cell mode, this fires every ~1 second.
 * In lab mode, this fires more frequently (smaller batches).
 *===========================================================================*/

static accel_packet_t tx_packet; /* Static to avoid stack allocation */

static void burst_controller_thread_fn(void *p1, void *p2, void *p3) {
  ARG_UNUSED(p1);
  ARG_UNUSED(p2);
  ARG_UNUSED(p3);

  static uint8_t burst_id = 0;
  int err;

  LOG_INF("Burst controller thread started");

  while (1) {
    /* Wait for buffer to fill */
    k_sem_take(&burst_ready_sem, K_FOREVER);

    if (!accel_service_data_notify_enabled()) {
      /* Not connected or notifications not enabled - silently drain buffer */
      read_idx = write_idx;
      continue;
    }

    if (!mtu_ready) {
      /* MTU exchange not complete yet - drain buffer and wait */
      LOG_WRN("MTU not ready (current: %u, need: %u), draining %u samples",
              current_mtu, REQUIRED_MTU, write_idx - read_idx);
      read_idx = write_idx;
      continue;
    }

    LOG_INF("Starting burst %u: %u samples buffered", burst_id,
            (uint16_t)(write_idx - read_idx));

    /*
     * Robustness fix: Only send full packets available in buffer.
     * Prevents read_idx from overshooting write_idx (1024 is not divisible by
     * 24).
     */
    uint16_t samples_available = write_idx - read_idx;
    uint16_t packets_to_send = samples_available / SAMPLES_PER_PACKET;

    if (packets_to_send > PACKETS_PER_BURST) {
      packets_to_send = PACKETS_PER_BURST;
    }

    if (packets_to_send == 0) {
      continue;
    }

    if (accel_service_get_mode() == MODE_COINCELL_BURST) {
      /* Pause sampling during burst to prevent overflow & save power */
      sampling_paused = true;
    }

    for (uint16_t p = 0; p < packets_to_send; p++) {
      /* Re-check connection status before each packet */
      if (!accel_service_data_notify_enabled()) {
        LOG_WRN("Connection lost mid-burst, aborting");
        break;
      }

      /* Build packet */
      tx_packet.burst_id = burst_id;

      /* Read from Ring Buffer - Protected by Spinlock */
      k_spinlock_key_t key = k_spin_lock(&buffer_lock);
      for (uint16_t s = 0; s < SAMPLES_PER_PACKET; s++) {
        uint16_t src_idx =
            (read_idx + (p * SAMPLES_PER_PACKET) + s) & RING_BUFFER_MASK;
        tx_packet.samples[s] = ring_buffer[src_idx];
      }
      k_spin_unlock(&buffer_lock, key);

      /* Calculate CRC16 over header + samples (all but the last 2 bytes, which
       * are the CRC itself) */
      tx_packet.crc16 = crc16_ccitt(0xFFFF, (const uint8_t *)&tx_packet,
                                    ACCEL_PACKET_SIZE - 2);

      /* Send packet */
      err = accel_service_notify_packet(NULL, &tx_packet);
      if (err == 0) {
        packets_sent++;
      } else {
        packets_failed++;
        LOG_WRN("Packet %u failed: %d", p, err);
      }

      /* Inter-packet delay to prevent coin-cell brownout */
      if (accel_service_get_mode() == MODE_COINCELL_BURST) {
        k_sleep(K_MSEC(INTER_PACKET_DELAY_MS));
      }
    }

    /* Resume sampling */
    sampling_paused = false;

    /* Advance read pointer - Protected by Spinlock */
    k_spinlock_key_t key = k_spin_lock(&buffer_lock);
    read_idx += packets_to_send * SAMPLES_PER_PACKET;
    k_spin_unlock(&buffer_lock, key);

    /* Reset burst start time for next window */
    burst_start_ms = k_uptime_get_32();

    burst_id++;
    total_bursts++;

    LOG_INF("Burst complete: %u packets sent, %u failed%s", packets_sent,
            packets_failed,
            samples_overflowed > 0 ? " (OVERFLOW detected)" : "");
    if (samples_overflowed > 0) {
      LOG_WRN("Total dropped samples due to overflow: %u", samples_overflowed);
    }
  }
}

K_THREAD_DEFINE(burst_controller, 2048, burst_controller_thread_fn, NULL, NULL,
                NULL, 5, 0, 0); /* Priority 5 = lower than reader */

/*============================================================================
 * MPU6050 Initialization
 *===========================================================================*/

static int mpu6050_init(void) {
  uint8_t buf[2];
  int ret;

  /* Wake up MPU6050 */
  buf[0] = MPU6050_PWR_MGMT_1;
  buf[1] = 0x00; /* Clear sleep bit */
  ret = i2c_write(i2c_dev, buf, 2, MPU6050_ADDR);
  if (ret < 0) {
    LOG_ERR("Failed to wake MPU6050: %d", ret);
    return ret;
  }

  /* Set sample rate divider
   * DLPF enabled (CFG=3) -> Gyro Rate = 1kHz.
   * Sample Rate = 1kHz / (1 + SMPLRT_DIV).
   * We want 1kHz, so SMPLRT_DIV must be 0.
   */
  buf[0] = MPU6050_SMPLRT_DIV;
  buf[1] = 0;
  ret = i2c_write(i2c_dev, buf, 2, MPU6050_ADDR);
  if (ret < 0) {
    LOG_ERR("Failed to set sample rate: %d", ret);
    return ret;
  }

  /* Set DLPF to 44Hz bandwidth */
  buf[0] = MPU6050_CONFIG;
  buf[1] = 0x03;
  ret = i2c_write(i2c_dev, buf, 2, MPU6050_ADDR);
  if (ret < 0) {
    LOG_ERR("Failed to set DLPF: %d", ret);
    return ret;
  }

  /* Set accelerometer range to ±16g */
  buf[0] = MPU6050_ACCEL_CONFIG;
  buf[1] = 0x18; /* AFS_SEL = 3 → ±16g */
  ret = i2c_write(i2c_dev, buf, 2, MPU6050_ADDR);
  if (ret < 0) {
    LOG_ERR("Failed to set accel range: %d", ret);
    return ret;
  }

  LOG_INF("MPU6050 initialized: ±16g, 1kHz ODR, 44Hz DLPF");
  return 0;
}

/*============================================================================
 * BLE Connection Callbacks
 *===========================================================================*/

/* Forward declare MTU exchange callback and params */
static void mtu_exchange_cb(struct bt_conn *conn, uint8_t err,
                            struct bt_gatt_exchange_params *params);

static struct bt_gatt_exchange_params mtu_exchange_params = {
    .func = mtu_exchange_cb,
};

static void connected(struct bt_conn *conn, uint8_t err) {
  if (err) {
    LOG_ERR("Connection failed (err %u)", err);
    return;
  }

  LOG_INF("Connected");

  /* LED only in lab mode to save coin-cell power */
  if (accel_service_get_mode() == MODE_CONTINUOUS_LAB) {
    dk_set_led_on(DK_LED1);
  }

  /* Request fast connection interval for high throughput */
  struct bt_le_conn_param *param =
      BT_LE_CONN_PARAM(6, 12, 0, 400); // 7.5ms - 15ms
  int err_param = bt_conn_le_param_update(conn, param);
  if (err_param) {
    LOG_WRN("Conn param update failed: %d", err_param);
  }

  accel_service_set_conn(conn);

  /* Reset MTU state */
  mtu_ready = false;
  current_mtu = 23;

  /* Request MTU exchange for large packets */
  int ret = bt_gatt_exchange_mtu(conn, &mtu_exchange_params);
  if (ret) {
    LOG_ERR("MTU exchange request failed (err %d)", ret);
  } else {
    LOG_INF("MTU exchange requested");
  }

  /* Reset burst timing on new connection */
  burst_start_ms = k_uptime_get_32();
  sample_counter = 0;
}

static void disconnected(struct bt_conn *conn, uint8_t reason) {
  LOG_INF("Disconnected (reason %u)", reason);
  dk_set_led_off(DK_LED1); /* Always safe to turn off */

  accel_service_set_conn(NULL); /* Resets CCC state */
  mtu_ready = false;
  current_mtu = 23;
}

static void le_param_updated(struct bt_conn *conn, uint16_t interval,
                             uint16_t latency, uint16_t timeout) {
  LOG_INF("Connection params: interval=%u (%.2f ms), latency=%u, timeout=%u",
          interval, interval * 1.25, latency, timeout);
}

/* GATT MTU exchange callback implementation */
static void mtu_exchange_cb(struct bt_conn *conn, uint8_t err,
                            struct bt_gatt_exchange_params *params) {
  if (err) {
    LOG_ERR("MTU exchange failed (err %u)", err);
    return;
  }

  current_mtu = bt_gatt_get_mtu(conn);
  LOG_INF("MTU exchanged: %u bytes", current_mtu);

  if (current_mtu >= REQUIRED_MTU) {
    mtu_ready = true;
    LOG_INF("MTU ready for 243-byte packets");
  } else {
    LOG_WRN("MTU %u too small for 243-byte packets (need %u)", current_mtu,
            REQUIRED_MTU);
  }
}

BT_CONN_CB_DEFINE(conn_callbacks) = {
    .connected = connected,
    .disconnected = disconnected,
    .le_param_updated = le_param_updated,
};

/*============================================================================
 * Advertising
 *===========================================================================*/

static const struct bt_data ad[] = {
    BT_DATA_BYTES(BT_DATA_FLAGS, (BT_LE_AD_GENERAL | BT_LE_AD_NO_BREDR)),
    BT_DATA(BT_DATA_NAME_COMPLETE, CONFIG_BT_DEVICE_NAME,
            sizeof(CONFIG_BT_DEVICE_NAME) - 1),
};

static const struct bt_data sd[] = {
    BT_DATA_BYTES(BT_DATA_UUID128_ALL, ACCEL_SERVICE_UUID_VAL),
};

/* Connectable advertising parameters */
static struct bt_le_adv_param adv_param = BT_LE_ADV_PARAM_INIT(
    BT_LE_ADV_OPT_CONN, BT_GAP_ADV_FAST_INT_MIN_2, /* 100 ms */
    BT_GAP_ADV_FAST_INT_MAX_2,                     /* 150 ms */
    NULL);

/*============================================================================
 * Main Entry Point
 *===========================================================================*/

int main(void) {
  int err;

  /* Soft Start: Wait for coin cell voltage to stabilize after insertions */
  k_sleep(K_MSEC(2000)); /* Give battery 2s (Rev 5.2) to recover voltage */

  /* Initialize LEDs first to indicate alive status */
  err = dk_leds_init();
  if (err) {
    LOG_ERR("LED init failed (err %d)", err);
  }
  /* Boot LED: OFF (Max Power Saving) */
  dk_set_led_off(DK_LED1);

  /* Power-safe enforcement: Ensure structures match BLE packet requirements */
  BUILD_ASSERT(sizeof(accel_sample_t) == 10, "Sample must be 10 bytes");
  BUILD_ASSERT(sizeof(accel_packet_t) == 243, "Packet must be 243 bytes");
  BUILD_ASSERT(RING_BUFFER_SAMPLES == 1024, "Buffer must remain 1024 for FFT");

  LOG_INF("=========================================");
  LOG_INF("ISRO Coin-Cell Accelerometer Rev 5.2");
  LOG_INF("=========================================");
  LOG_INF("Sample format: %u bytes", ACCEL_SAMPLE_SIZE);
  LOG_INF("Packet format: %u bytes (%u samples)", ACCEL_PACKET_SIZE,
          SAMPLES_PER_PACKET);
  LOG_INF("Buffer depth: %u samples", RING_BUFFER_SAMPLES);
  LOG_INF("Packets per burst: %u", PACKETS_PER_BURST);

  /* Get I2C device */
  i2c_dev = DEVICE_DT_GET(DT_NODELABEL(i2c1)); /* Check I2C */
  if (!device_is_ready(i2c_dev)) {
    LOG_ERR("I2C device not ready");
    while (1) { /* Error Loop */
      dk_set_led_on(DK_LED1);
      k_sleep(K_MSEC(50));
      dk_set_led_off(DK_LED1);
      k_sleep(K_MSEC(50));
    }
  }
  LOG_INF("I2C device ready");

  /* Init MPU6050 */
  if (mpu6050_init() < 0) {
    LOG_ERR("MPU6050 init failed - Continuing in Safe Mode");
    /* Do NOT return. Allow BLE to start so we can see the error remotely */
  }

  /* CRITICAL BATTERY RECOVERY PAUSE */
  /* The MPU6050 init pulled a large current spike.
   * Sleep for 2 seconds to let the coin cell voltage bounce back
   * BEFORE we enable the Radio. */
  k_sleep(K_MSEC(2000));

  /* Init Bluetooth */
  err = bt_enable(NULL);
  if (err) {
    LOG_ERR("Bluetooth init failed (err %d)", err);
    return 0; /* Changed from void return */
  }
  LOG_INF("Bluetooth initialized");

  /* Load settings */
  if (IS_ENABLED(CONFIG_SETTINGS)) {
    settings_load();
  }

  /* Initialize accelerometer service */
  err = accel_service_init();
  if (err) {
    LOG_ERR("Accel service init failed (err %d)", err);
    return 0; /* Changed from void return */
  }

  /* Start advertising */
  err = bt_le_adv_start(&adv_param, ad, ARRAY_SIZE(ad), sd, ARRAY_SIZE(sd));
  if (err) {
    LOG_ERR("Advertising failed to start (err %d)", err);
    return err;
  }
  LOG_INF("Advertising started as '%s'", CONFIG_BT_DEVICE_NAME);

  /* Initialize burst start time */
  burst_start_ms = k_uptime_get_32();

  /* Start sample timer at 1 kHz */
  k_timer_start(&sample_timer, K_USEC(SAMPLE_PERIOD_US),
                K_USEC(SAMPLE_PERIOD_US));
  LOG_INF("Sampling started at %u Hz", SAMPLE_FREQ_HZ);

  /* Start diagnostics timer (every 10 seconds) */
  k_timer_start(&diagnostics_timer, K_SECONDS(10), K_SECONDS(10));

  /* Main loop - LED heartbeat only in lab mode */
  while (1) {
    if (accel_service_get_mode() == MODE_CONTINUOUS_LAB) {
      dk_set_led(DK_LED2, 1);
      k_sleep(K_MSEC(500));
      dk_set_led(DK_LED2, 0);
      k_sleep(K_MSEC(500));
    } else {
      /* Coin-cell mode: sleep longer, no LED blink */
      k_sleep(K_MSEC(1000));
    }
  }

  return 0;
}
```

## src/accel_service.c
```c
/**
 * @file accel_service.c
 * @brief Coin-Cell Wireless Accelerometer GATT Service Implementation
 *
 * Architecture: Rev 3 - Supports both burst and continuous modes
 */

#include <string.h>
#include <zephyr/bluetooth/bluetooth.h>
#include <zephyr/bluetooth/gatt.h>
#include <zephyr/bluetooth/uuid.h>
#include <zephyr/kernel.h>
#include <zephyr/logging/log.h>
#include <zephyr/sys/crc.h>

#include "accel_service.h"

LOG_MODULE_REGISTER(accel_svc, LOG_LEVEL_INF);

/*============================================================================
 * Configuration
 *===========================================================================*/

#define SAMPLING_RATE_HZ 1000

/*============================================================================
 * State Variables
 *===========================================================================*/

static bool data_notify_enabled = false;
static bool timestamp_notify_enabled = false;
static struct bt_conn *current_conn = NULL;
static operating_mode_t current_mode = MODE_COINCELL_BURST;

/* Cached attribute pointers - resolved at init, not hard-coded indices */
static const struct bt_gatt_attr *accel_data_attr = NULL;
static const struct bt_gatt_attr *timestamp_attr = NULL;

/* External power detection stub - TODO: implement ADC check */
static bool external_power_detected = false;
/*============================================================================
 * Static Metadata
 *===========================================================================*/

static uint16_t sampling_rate = SAMPLING_RATE_HZ;
static uint32_t current_timestamp = 0;

static sensor_metadata_t sensor_meta = {
    .sensor_name = "ISRO_Phase3_Accel", .range_g = 16, .unit = "g"};

/*============================================================================
 * CCC Callbacks
 *===========================================================================*/

static void accel_data_ccc_changed(const struct bt_gatt_attr *attr,
                                   uint16_t value) {
  data_notify_enabled = (value == BT_GATT_CCC_NOTIFY);
  LOG_INF("Acceleration Data notifications %s",
          data_notify_enabled ? "ENABLED" : "DISABLED");
}

static void timestamp_ccc_changed(const struct bt_gatt_attr *attr,
                                  uint16_t value) {
  timestamp_notify_enabled = (value == BT_GATT_CCC_NOTIFY);
  LOG_INF("Timestamp notifications %s",
          timestamp_notify_enabled ? "enabled" : "disabled");
}

/*============================================================================
 * Read Callbacks
 *===========================================================================*/

static ssize_t read_timestamp(struct bt_conn *conn,
                              const struct bt_gatt_attr *attr, void *buf,
                              uint16_t len, uint16_t offset) {
  current_timestamp = (uint32_t)k_uptime_get();
  return bt_gatt_attr_read(conn, attr, buf, len, offset, &current_timestamp,
                           sizeof(current_timestamp));
}

static ssize_t read_sampling_rate(struct bt_conn *conn,
                                  const struct bt_gatt_attr *attr, void *buf,
                                  uint16_t len, uint16_t offset) {
  return bt_gatt_attr_read(conn, attr, buf, len, offset, &sampling_rate,
                           sizeof(sampling_rate));
}

static ssize_t read_sensor_meta(struct bt_conn *conn,
                                const struct bt_gatt_attr *attr, void *buf,
                                uint16_t len, uint16_t offset) {
  return bt_gatt_attr_read(conn, attr, buf, len, offset, &sensor_meta,
                           sizeof(sensor_meta));
}

static ssize_t read_operating_mode(struct bt_conn *conn,
                                   const struct bt_gatt_attr *attr, void *buf,
                                   uint16_t len, uint16_t offset) {
  uint8_t mode_byte = (uint8_t)current_mode;
  return bt_gatt_attr_read(conn, attr, buf, len, offset, &mode_byte,
                           sizeof(mode_byte));
}

static ssize_t write_operating_mode(struct bt_conn *conn,
                                    const struct bt_gatt_attr *attr,
                                    const void *buf, uint16_t len,
                                    uint16_t offset, uint8_t flags) {
  if (len != 1) {
    return BT_GATT_ERR(BT_ATT_ERR_INVALID_ATTRIBUTE_LEN);
  }

  uint8_t requested = ((const uint8_t *)buf)[0];

  /* Power-safety enforcement: block continuous mode without external power */
  if (requested == MODE_CONTINUOUS_LAB) {
    if (!external_power_detected) {
      LOG_WRN("Rejecting CONTINUOUS mode: no external power");
      return BT_GATT_ERR(BT_ATT_ERR_WRITE_NOT_PERMITTED);
    }
    current_mode = MODE_CONTINUOUS_LAB;
    LOG_INF("Mode switched to CONTINUOUS (Lab)");
  } else {
    current_mode = MODE_COINCELL_BURST;
    LOG_INF("Mode switched to BURST (Coin-cell)");
  }

  return len;
}

/*============================================================================
 * GATT Service Definition
 *===========================================================================*/

BT_GATT_SERVICE_DEFINE(
    accel_svc,
    /* Primary Service Declaration */
    BT_GATT_PRIMARY_SERVICE(ACCEL_SERVICE_UUID),

    /* Acceleration Data Characteristic (NOTIFY only) */
    BT_GATT_CHARACTERISTIC(ACCEL_DATA_CHAR_UUID, BT_GATT_CHRC_NOTIFY,
                           BT_GATT_PERM_NONE, NULL, NULL, NULL),
    BT_GATT_CCC(accel_data_ccc_changed, BT_GATT_PERM_READ | BT_GATT_PERM_WRITE),

    /* Timestamp Characteristic (READ | NOTIFY) */
    BT_GATT_CHARACTERISTIC(TIMESTAMP_CHAR_UUID,
                           BT_GATT_CHRC_READ | BT_GATT_CHRC_NOTIFY,
                           BT_GATT_PERM_READ, read_timestamp, NULL, NULL),
    BT_GATT_CCC(timestamp_ccc_changed, BT_GATT_PERM_READ | BT_GATT_PERM_WRITE),

    /* Sampling Rate Characteristic (READ only) */
    BT_GATT_CHARACTERISTIC(SAMPLE_RATE_CHAR_UUID, BT_GATT_CHRC_READ,
                           BT_GATT_PERM_READ, read_sampling_rate, NULL, NULL),

    /* Sensor Metadata Characteristic (READ only) */
    BT_GATT_CHARACTERISTIC(SENSOR_META_CHAR_UUID, BT_GATT_CHRC_READ,
                           BT_GATT_PERM_READ, read_sensor_meta, NULL, NULL),

    /* Operating Mode Characteristic (READ | WRITE) */
    BT_GATT_CHARACTERISTIC(OPERATING_MODE_CHAR_UUID,
                           BT_GATT_CHRC_READ | BT_GATT_CHRC_WRITE,
                           BT_GATT_PERM_READ | BT_GATT_PERM_WRITE,
                           read_operating_mode, write_operating_mode, NULL), );

/*============================================================================
 * API Implementation
 *===========================================================================*/

int accel_service_init(void) {
  /* Resolve attribute pointers to avoid hard-coded indices */
  accel_data_attr = bt_gatt_find_by_uuid(accel_svc.attrs, accel_svc.attr_count,
                                         ACCEL_DATA_CHAR_UUID);
  timestamp_attr = bt_gatt_find_by_uuid(accel_svc.attrs, accel_svc.attr_count,
                                        TIMESTAMP_CHAR_UUID);

  if (!accel_data_attr || !timestamp_attr) {
    LOG_ERR("Failed to find GATT attributes");
    return -EINVAL;
  }

  LOG_INF("Accelerometer GATT Service initialized (Rev 3)");
  LOG_INF("  Sample size: %u bytes", ACCEL_SAMPLE_SIZE);
  LOG_INF("  Packet size: %u bytes (%u samples)", ACCEL_PACKET_SIZE,
          SAMPLES_PER_PACKET);
  LOG_INF("  Packets per burst: %u", PACKETS_PER_BURST);
  LOG_INF("  Initial mode: %s",
          current_mode == MODE_COINCELL_BURST ? "BURST" : "CONTINUOUS");
  return 0;
}

int accel_service_notify_packet(struct bt_conn *conn,
                                const accel_packet_t *packet) {
  if (!data_notify_enabled) {
    return -ENOTCONN;
  }

  struct bt_conn *target = conn ? conn : current_conn;
  if (!target) {
    return -ENOTCONN;
  }

  /* Packet already includes CRC, just send it */
  return bt_gatt_notify(target, accel_data_attr, packet, ACCEL_PACKET_SIZE);
}

int accel_service_notify_timestamp(struct bt_conn *conn, uint32_t uptime_ms) {
  if (!timestamp_notify_enabled) {
    return -ENOTCONN;
  }

  struct bt_conn *target = conn ? conn : current_conn;
  if (!target) {
    return -ENOTCONN;
  }

  return bt_gatt_notify(target, timestamp_attr, &uptime_ms, sizeof(uptime_ms));
}

bool accel_service_data_notify_enabled(void) {
  return data_notify_enabled && (current_conn != NULL);
}

void accel_service_set_conn(struct bt_conn *conn) {
  if (current_conn) {
    bt_conn_unref(current_conn);
  }
  current_conn = conn ? bt_conn_ref(conn) : NULL;

  if (!current_conn) {
    /* Reset CCC state on disconnect to ensure safety */
    data_notify_enabled = false;
    timestamp_notify_enabled = false;
    LOG_INF("CCC state reset on disconnect");
  }
}

operating_mode_t accel_service_get_mode(void) { return current_mode; }

int accel_service_set_mode(operating_mode_t mode, bool power_detected) {
  /* Update static state for GATT callbacks */
  external_power_detected = power_detected;

  if (mode == MODE_CONTINUOUS_LAB && !external_power_detected) {
    LOG_WRN("Cannot switch to CONTINUOUS mode without external power");
    return -EPERM;
  }

  current_mode = mode;
  LOG_INF("Operating mode set to %s",
          mode == MODE_COINCELL_BURST ? "BURST" : "CONTINUOUS");
  return 0;
}

void accel_service_set_power_detected(bool detected) {
  external_power_detected = detected;
  if (!detected && current_mode == MODE_CONTINUOUS_LAB) {
    LOG_WRN("External power lost, reverting to BURST mode");
    current_mode = MODE_COINCELL_BURST;
  }
}
```

## src/accel_service.h
```c
/**
 * @file accel_service.h
 * @brief Coin-Cell Wireless Accelerometer GATT Service
 *
 * Architecture: Rev 3 - Burst mode with 10-byte samples, 24 samples/packet
 */

#ifndef ACCEL_SERVICE_H_
#define ACCEL_SERVICE_H_

#include <zephyr/bluetooth/conn.h>
#include <zephyr/types.h>

#ifdef __cplusplus
extern "C" {
#endif

/*============================================================================
 * GATT UUIDs
 *===========================================================================*/

/* Custom Service UUID: 12340000-1234-5678-9ABC-DEF012345678 */
#define ACCEL_SERVICE_UUID_VAL                                                 \
  BT_UUID_128_ENCODE(0x12340000, 0x1234, 0x5678, 0x9ABC, 0xDEF012345678)

/* Acceleration Data Characteristic UUID: 12340001-... (NOTIFY) */
#define ACCEL_DATA_CHAR_UUID_VAL                                               \
  BT_UUID_128_ENCODE(0x12340001, 0x1234, 0x5678, 0x9ABC, 0xDEF012345678)

/* Timestamp Characteristic UUID: 12340002-... (READ | NOTIFY) */
#define TIMESTAMP_CHAR_UUID_VAL                                                \
  BT_UUID_128_ENCODE(0x12340002, 0x1234, 0x5678, 0x9ABC, 0xDEF012345678)

/* Sampling Rate Characteristic UUID: 12340003-... (READ) */
#define SAMPLE_RATE_CHAR_UUID_VAL                                              \
  BT_UUID_128_ENCODE(0x12340003, 0x1234, 0x5678, 0x9ABC, 0xDEF012345678)

/* Sensor Metadata (TEDS) Characteristic UUID: 12340004-... (READ) */
#define SENSOR_META_CHAR_UUID_VAL                                              \
  BT_UUID_128_ENCODE(0x12340004, 0x1234, 0x5678, 0x9ABC, 0xDEF012345678)

/* Operating Mode Characteristic UUID: 12340005-... (READ | WRITE) */
#define OPERATING_MODE_CHAR_UUID_VAL                                           \
  BT_UUID_128_ENCODE(0x12340005, 0x1234, 0x5678, 0x9ABC, 0xDEF012345678)

#define ACCEL_SERVICE_UUID BT_UUID_DECLARE_128(ACCEL_SERVICE_UUID_VAL)
#define ACCEL_DATA_CHAR_UUID BT_UUID_DECLARE_128(ACCEL_DATA_CHAR_UUID_VAL)
#define TIMESTAMP_CHAR_UUID BT_UUID_DECLARE_128(TIMESTAMP_CHAR_UUID_VAL)
#define SAMPLE_RATE_CHAR_UUID BT_UUID_DECLARE_128(SAMPLE_RATE_CHAR_UUID_VAL)
#define SENSOR_META_CHAR_UUID BT_UUID_DECLARE_128(SENSOR_META_CHAR_UUID_VAL)
#define OPERATING_MODE_CHAR_UUID                                               \
  BT_UUID_DECLARE_128(OPERATING_MODE_CHAR_UUID_VAL)

/*============================================================================
 * Operating Modes
 *===========================================================================*/

typedef enum {
  MODE_COINCELL_BURST = 0x00, /* Default: ~1s latency, power-gated network */
  MODE_CONTINUOUS_LAB = 0x01  /* Lab: ≤40ms latency, network always on */
} operating_mode_t;

/*============================================================================
 * Sample Format (10 bytes, packed)
 *
 * Per architecture Rev 3:
 * - sample_counter: 16-bit, wraps at 65535 (~65s @ 1kHz)
 * - rel_timestamp_ms: 16-bit, ms from burst start, no wrap in 1s
 * - accel_xyz: 6 bytes, signed raw counts (±16g range)
 *===========================================================================*/

typedef struct __attribute__((packed)) {
  uint16_t sample_counter;   /* 2 bytes - monotonic, loss detection */
  uint16_t rel_timestamp_ms; /* 2 bytes - ms since burst_start_ms in main.c */
  int16_t accel_x;           /* 2 bytes */
  int16_t accel_y;           /* 2 bytes */
  int16_t accel_z;           /* 2 bytes */
} accel_sample_t;            /* TOTAL = 10 bytes */

#define ACCEL_SAMPLE_SIZE sizeof(accel_sample_t) /* 10 */

/*============================================================================
 * Packet Format (243 bytes)
 *
 * Per architecture Rev 3:
 * - 24 samples per packet (24 × 10 = 240 bytes)
 * - 1 byte header (burst_id)
 * - 2 bytes CRC16
 * - Fits in BLE MTU (244 bytes)
 *===========================================================================*/

#define SAMPLES_PER_PACKET 24
#define PACKET_PAYLOAD_SIZE (SAMPLES_PER_PACKET * ACCEL_SAMPLE_SIZE) /* 240 */

typedef struct __attribute__((packed)) {
  uint8_t burst_id;                           /* 1 byte - burst sequence */
  accel_sample_t samples[SAMPLES_PER_PACKET]; /* 240 bytes */
  uint16_t crc16;                             /* 2 bytes - integrity check */
} accel_packet_t;                             /* TOTAL = 243 bytes */

#define ACCEL_PACKET_SIZE sizeof(accel_packet_t) /* 243 */

/*============================================================================
 * Ring Buffer Configuration
 *
 * 1024 samples = 1.024 seconds @ 1kHz (FFT-friendly)
 * 43 packets per burst (ceil(1024/24))
 *===========================================================================*/

#define RING_BUFFER_SAMPLES 1024
#define RING_BUFFER_MASK (RING_BUFFER_SAMPLES - 1) /* 0x3FF */
#define PACKETS_PER_BURST 43                       /* ceil(1024/24) */

/*============================================================================
 * Sensor Metadata (TEDS-like)
 *===========================================================================*/

typedef struct __attribute__((packed)) {
  char sensor_name[24];
  int16_t range_g;
  char unit[8];
} sensor_metadata_t;

/*============================================================================
 * API Functions
 *===========================================================================*/

/**
 * @brief Initialize the Accelerometer GATT Service
 * @return 0 on success, negative errno on failure
 */
int accel_service_init(void);

/**
 * @brief Send a complete burst packet (243 bytes)
 * @param conn Connection object (NULL for all connections)
 * @param packet Pointer to packet structure
 * @return 0 on success, negative errno on failure
 */
int accel_service_notify_packet(struct bt_conn *conn,
                                const accel_packet_t *packet);

/**
 * @brief Send timestamp notification
 * @param conn Connection object (NULL for all connections)
 * @param uptime_ms Current uptime in milliseconds
 * @return 0 on success, negative errno on failure
 */
int accel_service_notify_timestamp(struct bt_conn *conn, uint32_t uptime_ms);

/**
 * @brief Check if notifications are enabled for acceleration data
 * @return true if enabled, false otherwise
 */
bool accel_service_data_notify_enabled(void);

/**
 * @brief Set the current connection reference
 * @param conn Connection object
 */
void accel_service_set_conn(struct bt_conn *conn);

/**
 * @brief Get current operating mode
 * @return Current mode (MODE_COINCELL_BURST or MODE_CONTINUOUS_LAB)
 */
operating_mode_t accel_service_get_mode(void);

/**
 * @brief Set operating mode (only if external power detected)
 * @param mode Requested mode
 * @param external_power_detected true if USB/external power present
 * @return 0 on success, -EPERM if trying to set LAB mode without power
 */
int accel_service_set_mode(operating_mode_t mode, bool external_power_detected);

/**
 * @brief Update external power state for mode switching permission
 * @param detected true if USB/external power is present
 */
void accel_service_set_power_detected(bool detected);

#ifdef __cplusplus
}
#endif

#endif /* ACCEL_SERVICE_H_ */
```
